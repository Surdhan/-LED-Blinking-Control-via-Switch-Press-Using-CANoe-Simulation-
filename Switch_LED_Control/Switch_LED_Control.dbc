VERSION ""

NS_ :

BS_:

BU_: Switch_ECU LED_ECU

BO_ 1 LED_Message: 1 Vector__XXX
 SG_ LED_Signal : 0|8@1+ (1,0) [0|1] ""  LED_ECU

BO_ 0 Switch_Message: 1 Switch_ECU
 SG_ Switch_Signal : 0|8@1+ (1,0) [0|1] "" Vector__XXX

EV_ Env_Switch: 0 [0|1] "" 0 1 DUMMY_NODE_VECTOR0 Vector__XXX;

BA_DEF_  "BusType" STRING ;
BA_DEF_DEF_  "BusType" "CAN";
